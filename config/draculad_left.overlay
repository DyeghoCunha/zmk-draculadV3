
#include "draculad.dtsi"

&kscan0 {
    col-gpios
        = <&pro_micro_a 3 GPIO_ACTIVE_HIGH>
        , <&pro_micro_a 2 GPIO_ACTIVE_HIGH>
        , <&pro_micro_a 1 GPIO_ACTIVE_HIGH>
        , <&pro_micro_a 0 GPIO_ACTIVE_HIGH>
        , <&pro_micro_d 15 GPIO_ACTIVE_HIGH>
        ;
};

/ {
    ec11_left: encoder0 {
        compatible = "zmk,ec11-rotary-encoder";
        label = "EC11_LEFT";
        gpios = <&gpio0 10 GPIO_ACTIVE_LOW>, <&gpio0 11 GPIO_ACTIVE_LOW>;
        rotate-ccw = <&kp A>;
        rotate-cw  = <&kp B>;
    };
};

};
